## Documentation/devicetree/bindings/display/panel/ilitek,il97680a.yaml
```yaml
# SPDX-License-Identifier: (GPL-2.0-only OR BSD-2-Clause)
%YAML 1.2
---
$id: http://devicetree.org/schemas/display/panel/ilitek,il97680a.yaml#
$schema: http://devicetree.org/meta-schemas/core.yaml#

title: Ilitek IL97680A based DSI panels

maintainers:
  - Teguh Sobirin <teguh@sobir.in>

description:
  The Ilitek IL97680A is a DSI display driver IC driving the 1280x960
  command mode panels of the RetroidPocket handhelds.

allOf:
  - $ref: panel-common.yaml#

properties:
  compatible:
    enum:
      - retroidpocket,rpduo-panel-bottom
      - retroidpocket,rpnova-panel

  reg:
    maxItems: 1

  vdd-supply:
    description: Core voltage supply

  vddio-supply:
    description: I/O voltage supply

  vci-supply:
    description: Analog voltage supply

  vdd18-supply:
    description: 1.8V supply of the panel module

  vdd28-supply:
    description: 2.8V supply of the panel module

  reset-gpios: true
  rotation: true
  port: true

required:
  - compatible
  - reg
  - vdd-supply
  - vddio-supply
  - vci-supply
  - reset-gpios
  - port

additionalProperties: false

examples:
  - |
    #include <dt-bindings/gpio/gpio.h>

    dsi {
        #address-cells = <1>;
        #size-cells = <0>;

        panel@0 {
            compatible = "retroidpocket,rpnova-panel";
            reg = <0>;

            vdd-supply = <&vreg_l11b_1p2>;
            vddio-supply = <&vreg_l12b_1p8>;
            vci-supply = <&vreg_l13b_3p0>;
            vdd18-supply = <&vdd_disp_1v8>;
            vdd28-supply = <&vdd_disp_2v8>;

            reset-gpios = <&tlmm 133 GPIO_ACTIVE_LOW>;

            port {
                panel_in: endpoint {
                    remote-endpoint = <&dsi0_out>;
                };
            };
        };
    };
...
```

## Documentation/devicetree/bindings/embedded-controller/samsung,galaxybook4-edge-ec.yaml
```yaml
# SPDX-License-Identifier: (GPL-2.0-only OR BSD-2-Clause)
%YAML 1.2
---
$id: http://devicetree.org/schemas/embedded-controller/samsung,galaxybook4-edge-ec.yaml#
$schema: http://devicetree.org/meta-schemas/core.yaml#

title: Samsung Galaxy Book4 Edge Embedded Controller

maintainers:
  - Antheas Kapenekakis <lkml@antheas.dev>

description: |
  The ENE KB9058 embedded controller exposes battery and AC adapter status
  and keyboard backlight control through a mailbox at its second I2C
  address. The battery register layout follows the Samsung Galaxy Book4
  Edge ACPI battery methods. A separate I2C interface reports events,
  signalled through the mailbox interface interrupt.

properties:
  compatible:
    enum:
      - samsung,galaxybook4-edge-ec
      - samsung,galaxybook4-edge-ec-events

  reg:
    maxItems: 1

  samsung,event-interface:
    $ref: /schemas/types.yaml#/definitions/phandle
    description:
      EC event interface on a separate I2C bus. The referenced node supplies
      its I2C address through reg. Events use the mailbox interface interrupt.
      The referenced node must be disabled to prevent independent enumeration;
      the mailbox driver creates and owns its I2C client.

  interrupts:
    maxItems: 1

required:
  - compatible
  - reg

allOf:
  - if:
      properties:
        compatible:
          const: samsung,galaxybook4-edge-ec
    then:
      required:
        - interrupts
    else:
      required:
        - status
      properties:
        status:
          const: disabled
        interrupts: false
        samsung,event-interface: false

additionalProperties: false

examples:
  - |
    #include <dt-bindings/interrupt-controller/irq.h>

    i2c {
        #address-cells = <1>;
        #size-cells = <0>;

        embedded-controller@64 {
            compatible = "samsung,galaxybook4-edge-ec";
            reg = <0x64>;
            samsung,event-interface = <&ec_events>;
            interrupt-parent = <&gpio0>;
            interrupts = <66 IRQ_TYPE_EDGE_FALLING>;
        };
    };

    i2c-events {
        #address-cells = <1>;
        #size-cells = <0>;

        ec_events: embedded-controller@62 {
            compatible = "samsung,galaxybook4-edge-ec-events";
            reg = <0x62>;
            status = "disabled";
        };
    };
...
```

## Documentation/devicetree/bindings/leds/heroic,htr3212.yaml
```yaml
# SPDX-License-Identifier: (GPL-2.0-only OR BSD-2-Clause)
%YAML 1.2
---
$id: http://devicetree.org/schemas/leds/heroic,htr3212.yaml#
$schema: http://devicetree.org/meta-schemas/core.yaml#

title: HEROIC HTR3212 12-channel LED controller

maintainers:
  - Teguh Sobirin <teguh@sobir.in>

description:
  The HTR3212 is a 12-channel LED driver with 8-bit PWM brightness control,
  configured over I2C.

properties:
  compatible:
    const: heroic,htr3212

  reg:
    maxItems: 1

  "#address-cells":
    const: 1

  "#size-cells":
    const: 0

  sdb-gpios:
    maxItems: 1
    description: GPIO connected to the SDB pin, asserted to enable the chip.

  vdd-supply:
    description: Power supply.

  always-on:
    type: boolean
    description: Keep the LEDs lit across system suspend.

patternProperties:
  "^led@[1-9a-c]$":
    type: object
    $ref: common.yaml#
    unevaluatedProperties: false

    properties:
      reg:
        description: LED output channel.
        minimum: 1
        maximum: 12

    required:
      - reg

required:
  - compatible
  - reg
  - "#address-cells"
  - "#size-cells"
  - vdd-supply

additionalProperties: false

examples:
  - |
    #include <dt-bindings/gpio/gpio.h>
    #include <dt-bindings/leds/common.h>

    i2c {
        #address-cells = <1>;
        #size-cells = <0>;

        led-controller@3c {
            compatible = "heroic,htr3212";
            reg = <0x3c>;
            #address-cells = <1>;
            #size-cells = <0>;

            sdb-gpios = <&tlmm 55 GPIO_ACTIVE_HIGH>;
            vdd-supply = <&vdd_led>;

            led@1 {
                reg = <1>;
                color = <LED_COLOR_ID_RED>;
            };

            led@2 {
                reg = <2>;
                color = <LED_COLOR_ID_GREEN>;
            };

            led@3 {
                reg = <3>;
                color = <LED_COLOR_ID_BLUE>;
            };
        };
    };
```

## Documentation/devicetree/bindings/media/qcom,x1p42100-camss.yaml
```yaml
# SPDX-License-Identifier: (GPL-2.0 OR BSD-2-Clause)
%YAML 1.2
---
$id: http://devicetree.org/schemas/media/qcom,x1p42100-camss.yaml#
$schema: http://devicetree.org/meta-schemas/core.yaml#

title: Qualcomm X1P42100 Camera Subsystem (CAMSS)

maintainers:
  - Antheas Kapenekakis <lkml@antheas.dev>

description:
  The CAMSS IP is a CSI decoder and ISP present on Qualcomm platforms.
  X1P42100 provides one full Image Front End.

properties:
  compatible:
    const: qcom,x1p42100-camss

  reg:
    maxItems: 4

  reg-names:
    items:
      - const: csid0
      - const: csid_wrapper
      - const: csiphy0
      - const: vfe0

  clocks:
    maxItems: 13

  clock-names:
    items:
      - const: camnoc_nrt_axi
      - const: camnoc_rt_axi
      - const: cpas_ahb
      - const: cpas_fast_ahb
      - const: cpas_vfe0
      - const: csid
      - const: csid_csiphy_rx
      - const: csiphy0
      - const: csiphy0_timer
      - const: gcc_axi_hf
      - const: gcc_axi_sf
      - const: vfe0
      - const: vfe0_fast_ahb

  interrupts:
    maxItems: 3

  interrupt-names:
    items:
      - const: csid0
      - const: csiphy0
      - const: vfe0

  interconnects:
    maxItems: 4

  interconnect-names:
    items:
      - const: ahb
      - const: hf_mnoc
      - const: sf_mnoc
      - const: sf_icp_mnoc

  iommus:
    maxItems: 2

  power-domains:
    items:
      - description: IFE0 GDSC - Image Front End, Global Distributed Switch Controller.
      - description: Titan Top GDSC - Titan ISP Block, Global Distributed Switch Controller.

  power-domain-names:
    items:
      - const: ife0
      - const: top

  vdd-csiphy-0p8-supply:
    description: 0.8V supply to a PHY.

  vdd-csiphy-1p2-supply:
    description: 1.2V supply to a PHY.

  ports:
    $ref: /schemas/graph.yaml#/properties/ports

    description: CSI input ports.

    properties:
      port@0:
        $ref: /schemas/graph.yaml#/$defs/port-base
        unevaluatedProperties: false

        properties:
          endpoint:
            $ref: video-interfaces.yaml#
            unevaluatedProperties: false

            properties:
              data-lanes:
                minItems: 1
                maxItems: 4

              bus-type:
                enum:
                  - 1 # MEDIA_BUS_TYPE_CSI2_CPHY
                  - 4 # MEDIA_BUS_TYPE_CSI2_DPHY

            required:
              - data-lanes

required:
  - compatible
  - reg
  - reg-names
  - clocks
  - clock-names
  - interrupts
  - interrupt-names
  - interconnects
  - interconnect-names
  - iommus
  - power-domains
  - power-domain-names
  - vdd-csiphy-0p8-supply
  - vdd-csiphy-1p2-supply
  - ports

additionalProperties: false
```

## Documentation/devicetree/bindings/power/supply/ene,kb9058-battery.yaml
```yaml
# SPDX-License-Identifier: (GPL-2.0-only OR BSD-2-Clause)
%YAML 1.2
---
$id: http://devicetree.org/schemas/power/supply/ene,kb9058-battery.yaml#
$schema: http://devicetree.org/meta-schemas/core.yaml#

title: ENE KB9058 embedded controller battery interface

maintainers:
  - Antheas Kapenekakis <lkml@antheas.dev>

description: |
  The ENE KB9058 embedded controller exposes battery and AC adapter status
  through a mailbox at its second I2C address. The register layout follows
  the Samsung Galaxy Book4 Edge ACPI battery methods.

properties:
  compatible:
    const: ene,kb9058-battery

  reg:
    maxItems: 1

  interrupts:
    maxItems: 1

required:
  - compatible
  - reg
  - interrupts

additionalProperties: false

examples:
  - |
    #include <dt-bindings/interrupt-controller/irq.h>

    i2c {
        #address-cells = <1>;
        #size-cells = <0>;

        embedded-controller@64 {
            compatible = "ene,kb9058-battery";
            reg = <0x64>;
            interrupt-parent = <&gpio0>;
            interrupts = <66 IRQ_TYPE_EDGE_FALLING>;
        };
    };
...
```

## Documentation/devicetree/bindings/power/supply/samsung,galaxybook-ec-battery.yaml
```yaml
# SPDX-License-Identifier: (GPL-2.0-only OR BSD-2-Clause)
%YAML 1.2
---
$id: http://devicetree.org/schemas/power/supply/samsung,galaxybook-ec-battery.yaml#
$schema: http://devicetree.org/meta-schemas/core.yaml#

title: Samsung Galaxy Book4 Edge EC battery

maintainers:
  - Antheas Kapenekakis <lkml@antheas.dev>

description: |
  The Samsung EC exposes battery and AC adapter status through a mailbox
  on an I2C address listed in the machine ACPI ECTC resources.

properties:
  compatible:
    const: samsung,galaxybook-ec-battery

  reg:
    maxItems: 1

required:
  - compatible
  - reg

additionalProperties: false

examples:
  - |
    i2c {
        #address-cells = <1>;
        #size-cells = <0>;

        battery@64 {
            compatible = "samsung,galaxybook-ec-battery";
            reg = <0x64>;
        };
    };
...
```

## Documentation/devicetree/bindings/usb/samsung,s2mm006.yaml
```yaml
# SPDX-License-Identifier: (GPL-2.0 OR BSD-2-Clause)
# Copyright (c) 2026 Antheas Kapenekakis <lkml@antheas.dev>
%YAML 1.2
---
$id: http://devicetree.org/schemas/usb/samsung,s2mm006.yaml#
$schema: http://devicetree.org/meta-schemas/core.yaml#

title: Samsung S2MM006 USB Type-C controller

maintainers:
  - Antheas Kapenekakis <lkml@antheas.dev>

description: |
  The S2MM006 controls Type-C attachment, power paths and USB Power Delivery
  on the Samsung Galaxy Book4 Edge NP750XQB. Its connector describes the USB
  data role, orientation and mode switch connections.

properties:
  compatible:
    const: samsung,s2mm006

  reg:
    maxItems: 1

  interrupts:
    maxItems: 1

  connector:
    $ref: /schemas/connector/usb-connector.yaml#

required:
  - compatible
  - reg
  - interrupts
  - connector

additionalProperties: false

examples:
  - |
    #include <dt-bindings/interrupt-controller/irq.h>

    i2c {
        #address-cells = <1>;
        #size-cells = <0>;

        pdic@33 {
            compatible = "samsung,s2mm006";
            reg = <0x33>;
            interrupt-parent = <&gpio0>;
            interrupts = <42 IRQ_TYPE_LEVEL_LOW>;

            connector {
                compatible = "usb-c-connector";
                power-role = "dual";
                data-role = "dual";
            };
        };
    };
...
```

## drivers/custom/Kconfig
```kconfig
config AYN
    tristate "AYN Platform Driver"
    help
        AYN platform driver for Linux. Link:
        https://github.com/ShadowBlip/ayn-platform

config AYANEO
    tristate "AYANEO Legacy Platform Driver"
    help
        AYANEO Legacy platform driver for Linux. Link:
        https://github.com/ShadowBlip/ayaneo-platform

config BMI260
    tristate "BMI260 Legacy Driver"
    help
        BMI260 driver for Linux. Link:
        https://github.com/hhd-dev/bmi260

config XONE
    tristate "XONE Driver"
    help
        XONE driver for Linux. Link:
        https://github.com/anatase-org/xone

config FANATEC
    tristate "Fanatec Driver"
    help
        Fanatec driver for Linux. Link:
        https://github.com/gotzl/hid-fanatecff

config LG4FF
    tristate "New LG4FF Driver"
    help
        New LG4FF driver for Linux. Link:
        https://github.com/berarma/new-lg4ff

config TMFF2
    tristate "New TMFF Driver"
    help
        New TMFF driver for Linux. Link:
        https://github.com/Kimplul/hid-tmff2

config T150
    tristate "T150 Driver"
    help
        T150 driver for Linux. Link:
        https://github.com/scarburato/t150_driver

config RAZER
    tristate "OpenRazer Driver"
    help
        OpenRazer driver for Linux. Link:
        https://openrazer.github.io/

config S76
    tristate "System76 Driver"
    help
        System76 driver for Linux. Link:
        https://github.com/pop-os/system76-dkms

config S76IO
    tristate "System76 IO Driver"
    help
        System76 IO driver for Linux. Link:
        https://github.com/pop-os/system76-io-dkms

source "drivers/custom/evdi/module/Kconfig"

config V4L2LOOP
    tristate "V4L2Loopback Driver"
    help
        V4L2Loopback driver for Linux. Link:
        https://github.com/umlaeute/v4l2loopback
```
